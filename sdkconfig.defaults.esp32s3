## sdkconfig.defaults.esp32s3
```kconfig
CONFIG_ESPTOOLPY_FLASHSIZE_16MB=y
CONFIG_ESPTOOLPY_FLASHMODE_QIO=y

CONFIG_ESP_DEFAULT_CPU_FREQ_MHZ_240=y

CONFIG_SPIRAM=y
CONFIG_SPIRAM_MODE_OCT=y
CONFIG_SPIRAM_SPEED_80M=y
CONFIG_SPIRAM_MALLOC_ALWAYSINTERNAL=4096
CONFIG_SPIRAM_TRY_ALLOCATE_WIFI_LWIP=y
CONFIG_SPIRAM_MALLOC_RESERVE_INTERNAL=49152
CONFIG_SPIRAM_MEMTEST=n
CONFIG_MBEDTLS_EXTERNAL_MEM_ALLOC=y

CONFIG_ESP32S3_INSTRUCTION_CACHE_32KB=y
CONFIG_ESP32S3_DATA_CACHE_64KB=y
CONFIG_ESP32S3_DATA_CACHE_LINE_64B=y

CONFIG_USE_WAKENET=y
CONFIG_SR_WN_WN9_NIHAOXIAOZHI_TTS=y
CONFIG_USE_MULTINET=n

# Enable IPv6
CONFIG_LWIP_IPV6=y
CONFIG_LWIP_IPV6_AUTOCONFIG=y
CONFIG_LWIP_IPV6_DHCP6=y
CONFIG_LWIP_IPV6_ND6_NUM_NEIGHBORS=10
CONFIG_LWIP_MAX_IPV6_ROUTES=16
CONFIG_LWIP_IPV6_MLD=y
CONFIG_LWIP_ICMP=y
CONFIG_LWIP_IPV6_MEMP_NUM_ND6_QUEUE=8
CONFIG_LWIP_IPV6_MEMP_NUM_MLD6_GROUP=4
CONFIG_LWIP_IPV6_ND6_RDNSS_MAX_DNS_SERVERS=2
CONFIG_LWIP_DEBUG=y
CONFIG_LWIP_IPV6_DEBUG=y
```
